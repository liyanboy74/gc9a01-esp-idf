## Kconfig
```kconfig
menu "GC9A01 LCD Config"
    config GC9A01_Width
        int "GC9A01 LCD Width"
        range 64 1024
        default 240

    config GC9A01_Height
        int "GC9A01 LCD Height"
        range 64 1024
        default 240
    #---------------------------------------------
    choice GC9A01_SPI_HOST
        prompt "GC9A01 SPI HOST"
        default USE_SPI3_HOST
        help
            Hardware SPI , HSPI=SPI2 , VSPI=SPI3

        config USE_SPI1_HOST
            bool "USE SPI1 HOST"
        config USE_SPI2_HOST
            bool "USE SPI2 HOST"
        config USE_SPI3_HOST
            bool "USE SPI3 HOST"
        config USE_SPI4_HOST
            bool "USE SPI4 HOST"
    endchoice

    config GC9A01_SPI_HOST
        int
        default 0 if USE_SPI1_HOST
        default 1 if USE_SPI2_HOST
        default 2 if USE_SPI3_HOST
        default 3 if USE_SPI4_HOST
    #---------------------------------------------

    config GC9A01_PIN_NUM_SCK
        int "LCD SPI SCK Pin"
        range 0 34
        default 18
        help
            Must Support SPI SCK

    config GC9A01_PIN_NUM_MOSI
        int "LCD SPI MOSI Pin"
        range 0 34
        default 23
        help
            Must Support SPI MOSI

    config GC9A01_PIN_NUM_CS
        int "LCD SPI CS Pin"
        range 0 34
        default 05

    config GC9A01_PIN_NUM_DC
        int "LCD DC(Data or Command) GPIO Pin Number"
        range 0 34
        default 21

    config GC9A01_SPI_SCK_FREQ_M
        int "SPI Clock Freq in MHz"
        range 1 80
        default 40

    config GC9A01_CONTROL_BACK_LIGHT_USED
        bool "LCD Control Back Light"
        default y

    config GC9A01_PIN_NUM_BCKL
        int "LCD BL(Back Light) GPIO Pin Number"
        depends on GC9A01_CONTROL_BACK_LIGHT_USED
        range 0 34
        default 19

    #---------------------------------------------
    choice GC9A01_CONTROL_BACK_LIGHT_MODE
        prompt "GC9A01b Control Back Light Mode"
        default GC9A01_BACK_LIGHT_MODE_PWM
        depends on GC9A01_CONTROL_BACK_LIGHT_USED
        help
            PWM use LEDC_TIMER_0 and LEDC_CHANNEL_0

        config GC9A01_BACK_LIGHT_MODE_On_OFF
            bool "USE GPIO ON/OF"
        config GC9A01_BACK_LIGHT_MODE_PWM
            bool "USE PWM"
    endchoice

    config GC9A01_CONTROL_BACK_LIGHT_MODE
        int
        default 0 if GC9A01_BACK_LIGHT_MODE_On_OFF
        default 1 if GC9A01_BACK_LIGHT_MODE_PWM
    #---------------------------------------------

    config GC9A01_RESET_USED
        bool "GC9A01 RESET Pin Used"
        default y
        help
            Use GC9A01 Hard Reset Pin

    config GC9A01_PIN_NUM_RST
        int "LCD RST GPIO Pin Number"
        depends on GC9A01_RESET_USED
        range 0 34
        default 22

    config GC9A01_BUFFER_MODE
        bool "Enable Buffer Mode"
        default y
        help
            Disable for Direct Mode

    config GC9A01_BUFFER_SCREEN_FAST_MODE
        bool "Don't Convert Buffer for Screen_Load() & Screen_Shot()"
        default n
        depends on GC9A01_BUFFER_MODE
        help
            If Enabled , the Screen_load() & Screen_Shot() don't run SwapBytes() for Buffer
            & Direct Save Data to SPI Buffer,So the data must manually SwapBytes before Send to LCD.

endmenu
```
